AUTOSAR XML (schema 4.0)
# SPDX-License-Identifier: MIT OR Apache-2.0
package /McalConfig
  module config Can
    4 x :
      CanController_0: CanControllerId=0, CanControllerBaudRate=500000
      CanController_1: CanControllerId=1, CanControllerBaudRate=250000
      CanHardwareObject_0: CanObjectId=0
      CanHardwareObject_1: CanObjectId=1
  module config Eth
    EthCtrlConfig_0 (): EthCtrlIdx=0, EthCtrlPhyAddress=02:00:00:00:00:01
  module config Fr
    FrController_0 (): FrCtrlIdx=0, FrCycleLengthUs=5000
  module config Dio
    DioChannel_0 (): DioChannelId=0
    DioChannel_31 (): DioChannelId=31
  module config Gpt
    GptChannel_0 (): GptChannelId=0
    GptChannel_3 (): GptChannelId=3
  module config Fls
    FlsSectorList (): FlsTotalSize=65536, FlsSectorSize=4096
